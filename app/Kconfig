## app/Kconfig
```kconfig
config REPO_VERSION_STRING
    string "Repository semver-compatible version string"

config REPO_VERSION_MAJOR
    int "Repository semver-compatible major version number"

config REPO_VERSION_MINOR
    int "Repository semver-compatible minor version number"

config REPO_VERSION_PATCH
    int "Repository semver-compatible patch version number"

config DAP_TCP_PORT
    int "Binding port for Dap driver TCP socket transport"
    default 30047

config IO_TCP_PORT
    int "Binding port for IO driver TCP socket transport"
    default 30059

config VCP_TCP_PORT
    int "Binding port for Virtual COM Port driver TCP socket transport"
    default 30071

config PRODUCT_MANUFACTURER
    string "Name of the product manufacturer"
    default "Nick Kraus"

config PRODUCT_DESCRIPTOR
    string "Short descriptor of the product"
    default "RICEProbe IO CMSIS-DAP"

config PRODUCT_SERIAL_FORMAT
    string "Defines the format and length of the product serial number"
    default "MMMM-YYWWNNNNNNC"

# USB descriptor values should inherit from the project descriptors
if USB_DEVICE_STACK

config USB_DEVICE_MANUFACTURER
    default PRODUCT_MANUFACTURER

config USB_DEVICE_PRODUCT
    default PRODUCT_DESCRIPTOR

config USB_DEVICE_SN
    default PRODUCT_SERIAL_FORMAT

endif # USB_DEVICE_STACK

module = DAP
module-str = dap
source "subsys/logging/Kconfig.template.log_config"

module = IO
module-str = io
source "subsys/logging/Kconfig.template.log_config"

module = VCP
module-str = vcp
source "subsys/logging/Kconfig.template.log_config"

source "Kconfig.zephyr"
```

## app/boards/arm/rice_nucleo_h743zi/Kconfig.board
```kconfig
config BOARD_RICE_NUCLEO_H743ZI
	bool "Remote ICE Nucleo H743ZI Development Board"
	depends on SOC_STM32H743XX
```

## app/boards/arm/rice_nucleo_h743zi/Kconfig.defconfig
```kconfig
if BOARD_RICE_NUCLEO_H743ZI

config BOARD
	default "rice_nucleo_h743zi"

endif # BOARD_RICE_NUCLEO_H743ZI
```

## app/boards/arm/rice_nucleo_h743zi/rice_nucleo_h743zi_defconfig
```kconfig
CONFIG_SOC_SERIES_STM32H7X=y
CONFIG_SOC_STM32H743XX=y

# Enable MPU
CONFIG_ARM_MPU=y

# Enable HW stack protection
CONFIG_HW_STACK_PROTECTION=y

# Enable GPIO
CONFIG_GPIO=y

# Enable clocks
CONFIG_CLOCK_CONTROL=y

# enable pin controller
CONFIG_PINCTRL=y
```

## app/boards/arm/rice_samv71b_xult/Kconfig.defconfig
```kconfig
if BOARD_RICE_SAMV71B_XULT

config BOARD
    default "rice_samv71b_xult"

if ETH_SAM_GMAC

# Read MAC address from AT24MAC402 EEPROM

config ETH_SAM_GMAC_MAC_I2C_EEPROM
	default y
	select I2C

config ETH_SAM_GMAC_MAC_I2C_INT_ADDRESS
	default 0x9A

config ETH_SAM_GMAC_MAC_I2C_INT_ADDRESS_SIZE
	default 1

endif # ETH_SAM_GMAC

if NETWORKING

config NET_L2_ETHERNET
	default y

endif # NETWORKING

if SERIAL

config USART_SAM
	default y

endif # SERIAL

endif # BOARD_RICE_SAMV71B_XULT
```

## app/boards/arm/rice_samv71b_xult/rice_samv71b_xult_defconfig
```kconfig
CONFIG_SOC_SERIES_SAMV71=y
CONFIG_SOC_PART_NUMBER_SAMV71Q21B=y
CONFIG_SOC_ATMEL_SAMV71_EXT_MAINCK=y
CONFIG_SOC_ATMEL_SAMV71_PLLA_MULA=24
CONFIG_SOC_ATMEL_SAMV71_PLLA_DIVA=1
CONFIG_ARM_MPU=y
CONFIG_CORTEX_M_SYSTICK=y
CONFIG_BOARD_RICE_SAMV71B_XULT=y
CONFIG_WDT_DISABLE_AT_BOOT=y
CONFIG_BUILD_OUTPUT_HEX=y

# Enable HW stack protection
CONFIG_HW_STACK_PROTECTION=y
```

## app/dts/bindings/rice_cmsis_dap.yaml
```yaml
description: CMSIS-DAP protocol driver

compatible: "rice,cmsis-dap"

properties:
    label:
      type: string
      required: true
    
    led_connect_gpios:
      type: phandle-array
      required: false
      description: Connect LED GPIO Pin.

        Outputs the connection status of the debug probe.
      
    led_running_gpios:
      type: phandle-array
      required: false
      description: Connect LED GPIO Pin.

        Outputs the running status of the debug probe.
```

## app/dts/bindings/rice_dap.yaml
```yaml
description: CMSIS-DAP protocol driver

compatible: "rice,dap"

properties:
    label:
      type: string
      required: true

    tck_swclk_gpios:
      type: phandle-array
      required: true
      description: JTAG TCK or SWD SWCLK GPIO Pin.

    tms_swdio_gpios:
      type: phandle-array
      required: true
      description: JTAG TMS or SWD SWDIO GPIO Pin.

    tdo_gpios:
      type: phandle-array
      required: true
      description: JTAG TDO GPIO Pin.

    tdi_gpios:
      type: phandle-array
      required: true
      description: JTAG TDI GPIO Pin.

    nreset_gpios:
      type: phandle-array
      required: true
      description: Active-low Reset GPIO Pin.
    
    vtref_gpios:
      type: phandle-array
      required: true
      description: Target IO Voltage Reference.

    led_connect_gpios:
      type: phandle-array
      required: true
      description: Connect LED GPIO Pin.

        Outputs the connection status of the debug probe.

    led_running_gpios:
      type: phandle-array
      required: true
      description: Connect LED GPIO Pin.

        Outputs the running status of the debug probe.
```

## firmware/boards/arm/rice_samv71b_xult/Kconfig.board
```kconfig
config BOARD_RICE_SAMV71B_XULT
	bool "Remote ICE ATSAMV71 Xplained Ultra Development Board"
	depends on SOC_PART_NUMBER_SAMV71Q21 || SOC_PART_NUMBER_SAMV71Q21B
```

## tests/dap/testcase.yaml
```yaml
tests:
  dap.test_info_command:
    platform_allow: native_posix_64
  dap.test_host_status:
    platform_allow: native_posix_64
  dap.test_delay:
    platform_allow: native_posix_64
  dap.test_reset_target:
    platform_allow: native_posix_64
  dap.test_disconnect_connect:
    platform_allow: native_posix_64
  dap.test_swj_pins:
    platform_allow: native_posix_64
  dap.test_swj_clock_sequence:
    platform_allow: native_posix_64
  dap.test_atomic:
    platform_allow: native_posix_64
```

## tests/nvs/testcase.yaml
```yaml
tests:
  nvs.test_nvs_init:
    platform_allow: native_posix_64
  nvs.test_nvs_serial:
    platform_allow: native_posix_64
  nvs.test_nvs_uuid:
    platform_allow: native_posix_64
  nvs.test_nvs_dns_sd:
    platform_allow: native_posix_64
```

## west/west.yml
```yaml
manifest:
  defaults:
    remote: zephyrproject-rtos

  self:
    path: app

  remotes:
    - name: zephyrproject-rtos
      url-base: https://github.com/zephyrproject-rtos

    - name: nick-kraus
      url-base: git@github.com:nick-kraus

  projects:
    - name: zephyr
      revision: v3.4.0-rc2
      west-commands: scripts/west-commands.yml

    # projects below are lifted from zephyr v3.4.0-rc2 west.yml, with unused projects removed
    - name: hal_atmel
      revision: 5ab43007eda3f380c125f957f03638d2e8d1144d
      path: modules/hal/atmel

    - name: hal_stm32
      revision: c865374fc83d93416c0f380e6310368ff55d6ce2
      path: modules/hal/stm32

    - name: cmsis
      revision: 74981bf893e8b10931464b9945e2143d99a3f0a3
      path: modules/hal/cmsis

    - name: mbedtls
      revision: 6e7841e5a08eb5da3c82dbc8b6b6d82ae4b7d2a0
      path: modules/crypto/mbedtls

    - name: mcuboot
      revision: a6aef32619455cb1697c42d66db489c1608f8410
      path: bootloader/mcuboot

    - name: net-tools
      revision: e0828aa9629b533644dc96ff6d1295c939bd713c
      path: tools/net-tools

    - name: picolibc
      revision: d07c38ff051386f8e09a143ea0a6c1d6d66dd1d8
      path: modules/lib/picolibc

    - name: segger
      revision: 4bfaf28a11c3e5ec29badac744fab6d2f342749e
      path: modules/debug/segger
```
